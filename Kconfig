## scripts/Kconfig.santa_clara
```kconfig
config PRECONDITION_PROVISION_SC
	bool "Use the Santa Clara method to provision drives"
	default y
	help
	  Enabling this option will force the Santa Clara method to kick in
	  even if no generic tests were enabled. This can be useful if you are
	  using fio-tests only to provision drives.

	  Note that if you want to accomplish the same with SNIA tests you can
	  simply run enable the SNIA tests and not enable any generic tests,
	  as the SNIA tests are very targetted specific tests in and of
	  themselves.

if PRECONDITION_PROVISION_SC

choice
	prompt "Santa Clara provision workload target"
	default PROVISION_SC_RANDOM

config PROVISION_SC_SEQUENTIAL
	bool "Provision for sequential workloads"
	help
	  If no generic tests are enabled you can select this option so that
	  the DUT is provisioned against sequential workloads using the Santa
	  Clara method.

config PROVISION_SC_RANDOM
	bool "Provision for random workloads"
	help
	  If no generic tests are enabled you can select this option so that
	  the DUT is provisioned against random workloads using the Santa
	  Clara method.

endchoice

endif # PRECONDITION_PROVISION_SC

# XXX: consider prefixing all these with _SC as these are santa clara method
# specific. This would only make sense if we will end up adding alternative
# generic methods.
config PRECONDITION_STRICT_ORDER
	bool "Pre-condition using strict order"
	default y
	help
	  Some benchmarks are produced by ensuring that even if you are not
	  running sequential writes, and want to gather performance benchmarks
	  only for random workloads, you'd still have to run pre-condioning
	  for sequential workloads first, and then after you'd perform the
	  random workload pre-conditioning.

	  This is the default behaviour, if you are sure you don't need this
	  disable it.

config SANTA_CLARA_ROUND_LIMIT
	string "Santa Clara steady state round critical limit"
	default "5" if !DEBUG_QUICK_DEFAULTS
	default DEBUG_ROUND_CRITICAL_LIMIT if DEBUG_QUICK_DEFAULTS
	help
	  The maximum amount of rounds to try running the workload dependent
	  specific steady state fio jobs for pre-conditioning before reaching
	  the critical limit. For instance, a sequential workload will have
	  two fio jobs for steady state: iops, and bandwidth. For sequential
	  workloads a round would consists of running both of these fio files.
	  We'd have a failure on the round if either of these fail. If the
	  critical limit is 5, then we'd try running both of these 2 fio
	  files 5 times before giving up. A successful round of both jobs
	  would be a success.

	  The limit is considered a hard limit unless the next option is
	  enabled, which would make this limit a soft limit.

config SANTA_CLARA_ROUND_LIMIT_SOFT
	bool "Make Santa Clara round critical limit a soft limit"
	default n
	help
	  Make the Santa Clara round critical limit a soft limit. This will
	  just log the fact that we have surpassed the critical limit, but
	  continue to loop forever until steady state is reached. Note that this
	  setting can be dangerous in the sense that you may have your hardware
	  loop forever if the tests run are not carved out for your hardware. Be
	  sure to first leave this disabled and ensure you can pass the test
	  regularly.

config PRECONDITION_BLOCKSIZE
	string "Pre-condition blocksize"
	default "128k"
	help
	  If 128k is set, this sets the fio bs=128k value for pre-conditioning.

	  The block size in bytes used for I/O units. Default: 128 KiB.
	  A single value applies to reads, writes, and trims. Comma-separated
	  values may be specified for reads, writes, and trims. A value not
	  terminated in a comma applies to subsequent types. Examples:

	  256k        means 256k for reads, writes and trims.
	  8k,32k      means 8k for reads, 32k for writes and trims.
	  8k,32k,     means 8k for reads, 32k for writes, and default for trims.
	  ,8k         means default for reads, 8k for writes and trims.
	  ,8k,        means default for reads, 8k for writes, and default for trims.

	  For more details on bs refer to the fio(1) manpage.

config PRECONDITION_IODEPTH
	string "Pre-conditioning iodepth"
	default "32" if ENTERPRISE_SSD_TESTING
	default "16" if !ENTERPRISE_SSD_TESTING
	help
	  Use this value for the fio iodepth=x for pre-conditioning.

config PRECONDITION_NUMJOBS
	string "Pre-conditioning number jobs / threads"
	default "4" if ENTERPRISE_SSD_TESTING
	default "2" if ENTERPRISE_SSD_TESTING
	help
	  If 16 is set, fio will use jobs=16 when pre-conditioning the drive.

	  For more details on jobs refer to the fio(1) manpage.

config PRECONDITION_PREFILL_LOOP
	int "Pre-condition pre-fill loop count"
	default "2" if !DEBUG_SHORT_LOOP
	default "1" if DEBUG_SHORT_LOOP
	help
	  How many times to pre-fill the drive with the pre-condition workload.
	  The current recommended settings is 2. If a value of 2 is used and
	  you are going to pre-condition for a sequential workload the drive
	  will be pre-filled twice. If however you however are not going to run
	  any sequential workload but are going to test a random workload, the
	  drive will first be pre-filled twice with the sequential workload, and
	  then twice with the random workload, prior to running the random
	  workload test.

config PRECONDITION_FIO_STEADY_STATE
	bool "Pre-condition using fio steady state mechanism after pre-fill"
	default y
	help
	  This will use fio's new steady state mechanism to pre-condition the
	  drives for specific targets prior to running any generic tests.

	  If unsure, enable this option.

if PRECONDITION_FIO_STEADY_STATE

config PRECONDITION_FIO_STEADY_STATE_IOPS
	bool "Ensure IOPS is steady before testing"
	default y
	help
	  This will use fio's steady state mechanism to ensure IOPS is steady
	  for the specified requirements, before allowing tests to go on.

if PRECONDITION_FIO_STEADY_STATE_IOPS

config IOPS_WD_SS_MEAN_LIMIT
	string "IOPS Steady state - limit boundary requirement"
	default "20%" if !DEBUG_QUICK_DEFAULTS
	default DEBUG_EASY_SS_MEAN_LIMIT if DEBUG_EASY_STEADY_STATE
	default DEBUG_DIFFICULT_SS_MEAN_LIMIT if DEBUG_DIFFICULT_STEADY_STATE
	help
	  This sets the limit within which all measured IOPS must be in from
	  the means IOPS observed. This sets the ss=iops value for fio. If set
	  to 20% this means steady state is attained if all individual IOPS
	  values must be within 20% of the mean IOPS for the duration of
	  workload dependent pre-condition setting:

	    * CONFIG_IOPS_WD_SS_MEAN_LIMIT_DUR

	  Instead of a percentage value this can also be an absolute value, for
	  instance if set to 120, it means that all individual IOPS values must
	  be within 120 of the mean.

	  For more details on this refer to the Steady state section on the
	  the fio(1) manpage.

config IOPS_WD_SS_MEAN_LIMIT_DUR
	string "IOPS Steady state - limit boundary duration"
	default "15m" if !DEBUG_QUICK_DEFAULTS
	default DEBUG_FAST_RUNTIME if DEBUG_QUICK_DEFAULTS
	help
	  This sets the amount of time during which the criteria for steady
	  state limit boundary requirement (CONFIG_IOPS_WD_SS_MEAN_LIMIT)
	  must be sustained for.

config IOPS_WD_SS_SLOPE
	string "IOPS Steady state - slope requirement"
	default "10%" if !DEBUG_QUICK_DEFAULTS
	default DEBUG_EASY_SS_SLOPE if DEBUG_EASY_STEADY_STATE
	default DEBUG_DIFFICULT_SS_SLOPE if DEBUG_DIFFICULT_STEADY_STATE
	help
	  This sets the least squares regression slope requirement. This sets
	  the ss:iops_slope value for fio. If set to 10% this means state is
	  attained if the least squares regression slope for IOPS is maintained
	  below 10% of  the  mean  IOPS during the duration of the workload
	  dependent pre-condition setting:

	    * CONFIG_IOPS_WD_SS_SLOPE_DUR

	  For more details on this refer to the Steady state section on the
	  the fio(1) manpage.

config IOPS_WD_SS_SLOPE_DUR
	string "IOPS Steady state - slope duration"
	default "15m" if !DEBUG_QUICK_DEFAULTS
	default DEBUG_FAST_RUNTIME if DEBUG_QUICK_DEFAULTS
	help
	  This sets the amount of time during which the criteria for steady
	  state slope requirement (CONFIG_IOPS_WD_SS_SLOPE)
	  must be sustained for.

endif

config PRECONDITION_FIO_STEADY_STATE_BW
	bool "Ensure throughput is steady before testing"
	default y
	help
	  This will use fio's steady state mechanism to ensure throughput is
	  steady for the specified requirements, before allowing tests to go on.

if PRECONDITION_FIO_STEADY_STATE_BW

config BW_WD_SS_MEAN_LIMIT
	string "Throughput Steady state - limit boundary requirement"
	default "20%" if !DEBUG_QUICK_DEFAULTS
	default DEBUG_EASY_SS_MEAN_LIMIT if DEBUG_EASY_STEADY_STATE
	default DEBUG_DIFFICULT_SS_MEAN_LIMIT if DEBUG_DIFFICULT_STEADY_STATE
	help
	  This sets the limit within which all measured throughput must be in
	  from the means throughput observed. This sets the ss=bw value for fio.
	  If set to 20% this means steady state is attained if all throughput
	  values recorded are within 20% of the mean throughput for the duration
	  of workload dependent pre-condition setting:

	    * CONFIG_BW_WD_SS_MEAN_LIMIT_DUR

	  For more details on this refer to the Steady state section on the
	  the fio(1) manpage.

config BW_WD_SS_MEAN_LIMIT_DUR
	string "Throughput Steady state - limit boundary duration"
	default "15m" if !DEBUG_QUICK_DEFAULTS
	default DEBUG_FAST_RUNTIME if DEBUG_QUICK_DEFAULTS
	help
	  This sets the amount of time during which the criteria for steady
	  state limit boundary requirement (CONFIG_BW_WD_SS_MEAN_LIMIT)
	  must be sustained for.

config BW_WD_SS_SLOPE
	string "Throughput Steady state - slope requirement"
	default "10%" if !DEBUG_QUICK_DEFAULTS
	default DEBUG_EASY_SS_SLOPE if DEBUG_EASY_STEADY_STATE
	default DEBUG_DIFFICULT_SS_SLOPE if DEBUG_DIFFICULT_STEADY_STATE
	help
	  This sets the least squares regression slope requirement. This sets
	  the ss:bw_slope value for fio. If set to 10% this means state is
	  attained if the least squares regression slope for throughput is
	  maintained below 10% of  the  mean  IOPS during the duration of the
	  workload dependent pre-condition setting:

	    * CONFIG_BW_WD_SS_SLOPE_DUR

	  For more details on this refer to the Steady state section on the
	  the fio(1) manpage.

config BW_WD_SS_SLOPE_DUR
	string "Throughput steady state - slope duration"
	default "15m" if !DEBUG_QUICK_DEFAULTS
	default DEBUG_FAST_RUNTIME if DEBUG_QUICK_DEFAULTS
	help
	  This sets the amount of time during which the criteria for steady
	  state slope requirement (CONFIG_BW_WD_SS_SLOPE)
	  must be sustained for.

endif # PRECONDITION_FIO_STEADY_STATE_BW

endif # PRECONDITION_FIO_STEADY_STATE
```

## scripts/Kconfig.steady-state
```kconfig
menu "Generic steady state provisioning"

config STEADY_STATE_PROVISIONING
	bool "Steady state provisioning prior to generic tests"
	default y
	help
	  Certain groups recommend and advise for certain provisioning work to
	  be performed on storage devices prior to doing any performance
	  analysis. This to ensure one can reproduce performance tests and
	  achieve consistent and reliable test benchmark numbers as often
	  published by manufacturers or test teams.

	  Getting drives to such state is referred to as "Steady State".
	  Methodologies to reach steady state provisioning vary depending on
	  storage technologies. Likewise, recommendations as to exactly how to
	  reach steady state may vary depending on goals and objectives. Note
	  that certain technologies may not require certain work items for
	  pre-conditioning as well.

	  The Storage Networking Industry Association (SNIA) put together
	  recommendations on procedures to follow for pre-conditioning and
	  testing solid state storage devices [0]. Each major SNIA test however
	  is designed to focus on measuring specific performance
	  characteristics. fio-tests supports a few interpretations of SNIA
	  tests as methods to attain steady-state prior to running the enabled
	  generic tests. A generic method, the Santa Clara method, is also
	  supported.

	  Enabling this option will mean you will select a method for attaining
	  steady state prior to running generic tests.

config FORCE_PRECONDITION
	bool "Force steady state work for all drives"
	default n
	help
	  Certain drives achieve steady state Fresh Out of the Box (FOB), they
	  do not require any pre-conditioning. An example are the Intel Optane
	  drives. By default fio-tests will check against a list of drives
	  which are known to not require pre-conditioning and skip it. If
	  you enable this option fio-tests will force pre-conditioning for
	  those drives as well.

	  You should leave this option disabled unless you want to confirm
	  the FOB steady-state nature of these drives. This may also be
	  useful if you want to use the results to reach steady-state with
	  these drives as the ideal criteria for steady state for other drives.

config ENERGIZED_STEADY_STATE
	bool "Perform energized steady state check"
	default y
	help
	  Certain newer technology drives do not require pre-conditioning FOB
	  but do require the drives to be energized for a period of time.
	  If the drives are de-engerized for a few weeks the drives can get
	  into de-engerized state and won't allow you to get the expected
	  steady state performance. Each drive may have its own requirement,
	  so this is drive / technology specific.

	  Enabling this option will ensure to wait drives are engergized
	  for at least the recommended period of time prior to allowing
	  performance benchmarking.

if STEADY_STATE_PROVISIONING

source "scripts/Kconfig.purge"
source "scripts/Kconfig.pre-condition"

endif

endmenu
```

## tests/0001-basic-tests/Kconfig
```kconfig
config BASIC_TESTS
	bool "Basic tests"
	depends on DUT_IODEPTH_RANGE
	help
	  This enables basic tests: for each IODEPTH 1 .. 4096
	  build tests for each profile we want to analyze. Only
	  one job is used.
```

## tests/0002-iobatch/Kconfig
```kconfig
config IODEPTH_BATCH
	bool "IO depth batch test"
	depends on DUT_IODEPTH_EXTRA_PARAMS
	depends on DUT_IODEPTH_BATCH_SUBMIT_RANGE
	depends on DUT_IODEPTH_BATCH_COMPLETE_RANGE
	depends on DUT_NUMJOBS_RANGE
	help
	  This enables basic tests: for each iodepth_batch_complete between
	  1 .. 4096 for each profile we want to analyze. We each test
	  iodepth_batch_complete with a range of jobs, between 1 and 64.

	  The goal with this test is to find the ideal max iodepth.
```

## tests/0003-maxiobatch-single-job/Kconfig
```kconfig
config MAX_IOBATCH_SINGLE
	bool "Max iodepth batch submit tests - single job"
	depends on DUT_IODEPTH_RANGE
	depends on DUT_IODEPTH_EXTRA_PARAMS
	depends on DUT_IODEPTH_BATCH_COMPLETE_RANGE
	help
	  This enables tests using the max batch submit we have deemed
	  appropriate, using a single job for all iodepths possible.
```

## tests/0004-maxiobatch-jobs/Kconfig
```kconfig
config MAX_IOBATCH_JOBS
	bool "Max iodepth batch submit tests - multiple job"
	depends on DUT_IODEPTH_EXTRA_PARAMS
	depends on DUT_IODEPTH_BATCH_COMPLETE_RANGE
	depends on DUT_IODEPTH_FOCUS_RANGE
	depends on DUT_NUMJOBS_RANGE
	help
	  This enables tests using the max batch submit we have deemed
	  appropriate, using a multiple job for a series of more appropriate
	  iodepths.
```
